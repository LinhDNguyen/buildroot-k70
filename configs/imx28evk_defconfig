## configs/imx28evk_defconfig
```kconfig
# Architecture
BR2_arm=y
BR2_cortex_a8=y
# BR2_SOFT_FLOAT is not set
BR2_VFP_FLOAT=y

# System
BR2_TARGET_GENERIC_GETTY_PORT="ttyAM0"
BR2_TARGET_UBOOT=y
BR2_TARGET_UBOOT_BOARDNAME="mx28_evk"
BR2_TARGET_UBOOT_CUSTOM_GIT=y
BR2_TARGET_UBOOT_CUSTOM_GIT_REPO_URL="/media/MOSTUSED/GitRepository/u-boot.git"
BR2_TARGET_UBOOT_CUSTOM_GIT_VERSION="imx28-evk"

# filesystem
BR2_TARGET_ROOTFS_EXT2=y

# Kernel
BR2_LINUX_KERNEL=y
BR2_LINUX_KERNEL_CUSTOM_GIT=y
BR2_LINUX_KERNEL_CUSTOM_GIT_REPO_URL="/media/MOSTUSED/GitRepository/linux-stable.git"
BR2_LINUX_KERNEL_CUSTOM_GIT_VERSION="imx28-evk-linux"
BR2_LINUX_KERNEL_DEFCONFIG="imx28evk"
```
